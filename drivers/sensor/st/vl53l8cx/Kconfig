## drivers/sensor/st/vl53l8cx/Kconfig
```kconfig
# VL53L8CX time of flight sensor configuration options

# Copyright (c) 2026 Bastien Auneau <bastien.auneau@while-true.fr>
# SPDX-License-Identifier: Apache-2.0

menuconfig VL53L8CX
	bool "VL53L8CX time of flight sensor"
	default y
	depends on DT_HAS_ST_VL53L8CX_ENABLED
	depends on ZEPHYR_HAL_ST_MODULE
	select HAS_STLIB
	select I2C
	select RTIO_WORKQ
	select SENSOR_ASYNC_API
	help
	  Enable driver for VL53L8CX I2C-based time of flight sensor.

if VL53L8CX

config VL53L8CX_INTERRUPT
	bool "Use interrupt mode, instead of poll, for VL53L8CX time of flight sensor"
	default y
	depends on GPIO
	help
	  Enable interrupt mode for VL53L8CX time of flight sensor. Otherwise,
	  the driver will poll via i2c.

config VL53L8CX_LOW_LEVEL_API
	bool
	default n
	help
	  Provide to user, a pointer to the low level STM provided API

config VL53L8CX_XCALIB
	bool "Enable Xtalk calibration"
	select VL53L8CX_LOW_LEVEL_API
	help
	  Add Xtalk calibration, from low level STM provided API

# TODO xcalib
# TODO sensor motion
# TODO get access to low level api ?


endif # VL53L8CX
```

## dts/bindings/sensor/st,vl53l8cx.yaml
```yaml
# Copyright (c) 2026 Bastien Auneau <bastien.auneau@while-true.fr>
# SPDX-License-Identifier: Apache-2.0

description: STMicroelectronics VL53L8CX Time of Flight sensor
include: [sensor-device.yaml, i2c-device.yaml]
compatible: "st,vl53l8cx"
on-bus: i2c

properties:
  lpn-gpios:
    type: phandle-array
    description: |
      Enables i2c communication. 0 to disable 1 to enable.
      Required to perform sensor reset in STM provided driver.
    required: true
  pwr-gpios:
    type: phandle-array
    description: |
      Control AVDD, IOVDD and CORE_1V8, which is required to 
      perform sensor reset in STM provided driver code.
    required: true
  rdy-gpios:
    type: phandle-array
    description: |
      An interrupt is raised when a distance measurement is ready.
      A1 (pin number) GPIO1 (signal name) is the interrupt pin.
      It is not mandatory, user can poll instead.
  sync-gpios:
    type: phandle-array
    description: |
      Optional SYNC input. B1 (pin number) GPIO2 (signal name).
      General purpose I/O, defaults to open drain output (tristate), 
      47 kΩ pullup resistor required to IOVDD.
```
